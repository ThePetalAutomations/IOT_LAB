/*
  Name:Bluetooth Controlled Home Automation
  Description:Using serial terminal Bluetooth app we can communicate the ESP32 and sending the appropriate 
 command to the ESP32 and applications will works.
  PINOUTS:
  Buzzer I/P= GPIO35
  LED1      = GPIO13
  Relay IN  = GPIO12
  OLED SCL  = GPIO22
  OLED SDA  = GPIO23
  PINOUTS FOR MOTOR DRIVER: 
  IN1 = GPIO14
  IN2 = GPIO27
  IN3 = GPIO26
  IN4 = GPIO25
 */
#include <BluetoothSerial.h>
#include <Adafruit_GFX.h>
#include <Adafruit_SSD1306.h>
#include <Fonts/FreeSerif9pt7b.h>
#define ledPIN 13
#define relayPin 12
#define buzzerPin 35
#define IN1 14
#define IN2 27
#define IN3 26
#define IN4 25
#define SCREEN_WIDTH 128 // OLED display width, in pixels
#define SCREEN_HEIGHT 64 // OLED display height, in pixels
Adafruit_SSD1306 display(SCREEN_WIDTH, SCREEN_HEIGHT, &Wire, -1);

static const unsigned char PROGMEM logoPetal [] = {//PETAL
  0xff, 0xff, 0xff, 0xff, 0xff, 0xff, 0xff, 0xff, 0xff, 0xff, 0xff, 0xff, 0xff, 0xff, 0xff, 0xff,
  0xff, 0xff, 0xff, 0xff, 0xff, 0xff, 0xff, 0xff, 0xff, 0xff, 0xff, 0xff, 0xff, 0xff, 0xff, 0xff,
  0xff, 0xff, 0xff, 0xff, 0xff, 0xff, 0xff, 0xff, 0xff, 0xff, 0xff, 0xff, 0xff, 0xff, 0xff, 0xff,
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  0xff, 0xff, 0xff, 0xff, 0xff, 0xff, 0xff, 0xff, 0xff, 0xff, 0xff, 0xff, 0xff, 0xff, 0xff, 0xff
};

BluetoothSerial SerialBT;
String message = "";

/* Check if Bluetooth configurations are enabled in the SDK */
#if !defined(CONFIG_BT_ENABLED) || !defined(CONFIG_BLUEDROID_ENABLED)
#error Bluetooth is not enabled! Please run `make menuconfig` to and enable it
#endif

void setup()
{
  pinMode(ledPIN, OUTPUT);
  Serial.begin(115200);
  SerialBT.begin();
  Serial.println("Bluetooth Started! Ready to pair...");
  if (!display.begin(SSD1306_SWITCHCAPVCC, 0x3C)) {
    Serial.println("SSD1306 allocation failed");
    for (;;);
  }
  delay(2000);
  display.clearDisplay();
  display.setFont(&FreeSerif9pt7b);
  display.setTextSize(1);
  display.setTextColor(WHITE);
  display.setCursor(50, 20);
  display.println("Petal");
  display.setCursor(20, 40);
  display.println("Automations");
  display.display();
  delay(2000);
  display.clearDisplay();
  display.display();
  display.clearDisplay();
  display.drawBitmap(0, 0, logoPetal, SCREEN_WIDTH, SCREEN_HEIGHT, 1);
  display.display();

}

void loop()
{
  if (SerialBT.available()) {
    char incomingChar = SerialBT.read();
    if (incomingChar != '\n') {
      message += String(incomingChar);
    }
    else {
      message = "";
    }
    Serial.write(incomingChar);
  }
  if (message == "ledon")
  {
    digitalWrite(ledPIN, HIGH);
    SerialBT.println("LED ON");
    display.clearDisplay();
    display.setCursor(0, 28);
    display.println("LED ON");
    display.display();
  }
  else if (message == "ledoff")
  {
    digitalWrite(ledPIN, LOW);
    SerialBT.println("LED OFF");
    display.clearDisplay();
    display.setCursor(0, 28);
    display.println("LED OFF");
    display.display();
  }

  else if (message == "relayon")
  {
    digitalWrite(relayPin, HIGH);
    SerialBT.println("RELAY ON");
    display.clearDisplay();
    display.setCursor(0, 28);
    display.println("RELAY ON");
    display.display();
  }
  else if (message == "relayoff")
  {
    digitalWrite(relayPin, LOW);
    SerialBT.println("RELAY OFF");
    display.clearDisplay();
    display.setCursor(0, 28);
    display.println("RELAY OFF");
    display.display();
  }

  else if (message == "start")
  {
    digitalWrite(IN1, LOW);
    digitalWrite(IN2, HIGH);
    digitalWrite(IN3, LOW);
    digitalWrite(IN4, HIGH);
    SerialBT.println("Motor Started");
    display.clearDisplay();
    display.setCursor(0, 28);
    display.println("Motor Started");
    display.display();

  }
  else if (message == "forward")
  {
    digitalWrite(IN1, LOW);
    digitalWrite(IN2, HIGH);
    digitalWrite(IN3, LOW);
    digitalWrite(IN4, HIGH);
    SerialBT.println("Motor forward");
    display.clearDisplay();
    display.setCursor(0, 28);
    display.println("Motor forward");
    display.display();
  }
  else if (message == "reverse")
  {
    digitalWrite(IN1, HIGH);
    digitalWrite(IN2, LOW);
    digitalWrite(IN3, HIGH);
    digitalWrite(IN4, LOW);
    SerialBT.println("Motor reversed");
    display.clearDisplay();
    display.setCursor(0, 28);
    display.println("Motor reversed");
    display.display();
  }
  else if (message == "stop")
  {
    digitalWrite(IN1, LOW);
    digitalWrite(IN2, LOW);
    digitalWrite(IN3, LOW);
    digitalWrite(IN4, LOW);
    SerialBT.println("Motor stopped");
    display.clearDisplay();
    display.setCursor(0, 28);
    display.println("Motor stopped");
    display.display();
  }

  else if (message == "buzzon")
  {
    digitalWrite(buzzerPin, HIGH);
    SerialBT.println("BUZZER ON");
    display.clearDisplay();
    display.setCursor(0, 28);
    display.println("BUZZER ON");
    display.display();
  }
  else if (message == "buzzoff")
  {
    digitalWrite(buzzerPin, LOW);
    SerialBT.println("BUZZER OFF");
    display.clearDisplay();
    display.setCursor(0, 28);
    display.println("BUZZER OFF");
    display.display();
  }
}
